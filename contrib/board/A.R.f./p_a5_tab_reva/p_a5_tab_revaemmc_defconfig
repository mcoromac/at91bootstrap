## contrib/board/A.R.f./p_a5_tab_reva/p_a5_tab_revaemmc_defconfig
```kconfig
CONFIG_P_A5_TAB_REVA=y
CONFIG_RAM_128MB=y
CONFIG_DDR2=y
CONFIG_SDCARD=y
CONFIG_SDHC0=y
CONFIG_DEBUG=y
CONFIG_ACT8865=y
CONFIG_PMIC_ON_TWI0=y
# CONFIG_ENTER_NWD is not set
# CONFIG_ACT8865_SET_VOLTAGE is not set
```
